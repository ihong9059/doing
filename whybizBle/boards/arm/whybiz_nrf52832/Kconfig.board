## whybizBle/boards/arm/whybiz_nrf52832/Kconfig.board
```kconfig
# Copyright (c) 2024 Nordic Semiconductor ASA
# SPDX-License-Identifier: Apache-2.0

config BOARD_WHYBIZ_NRF52832
	bool "whybiz_nrf52832"
	depends on SOC_NRF52832_QFAA
```

## whybizBle/boards/arm/whybiz_nrf52832/Kconfig.defconfig
```kconfig
# Copyright (c) 2024 Nordic Semiconductor ASA
# SPDX-License-Identifier: Apache-2.0

if BOARD_WHYBIZ_NRF52832

config BOARD
	default "whybiz_nrf52832"

config BT_CTLR
   default BT

endif
```

## whybizBle/build/Kconfig/Kconfig.shield
```kconfig
osource "/Users/honggwangseon/project/test/boards/shields/*/Kconfig.shield"
osource "/Users/honggwangseon/project/newBoards/boards/shields/*/Kconfig.shield"
osource "/Users/honggwangseon/project/doing/whybizBle/boards/shields/*/Kconfig.shield"
osource "/opt/nordic/ncs/v2.5.0/nrf/boards/shields/*/Kconfig.shield"
```

## whybizBle/build/Kconfig/Kconfig.shield.defconfig
```kconfig
osource "/Users/honggwangseon/project/test/boards/shields/*/Kconfig.defconfig"
osource "/Users/honggwangseon/project/newBoards/boards/shields/*/Kconfig.defconfig"
osource "/Users/honggwangseon/project/doing/whybizBle/boards/shields/*/Kconfig.defconfig"
osource "/opt/nordic/ncs/v2.5.0/nrf/boards/shields/*/Kconfig.defconfig"
```
